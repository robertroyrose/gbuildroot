## br-google/Config.in
```kconfig
source "$BR2_EXTERNAL_GPACKS_PATH/package/grpc/Config.in"
source "$BR2_EXTERNAL_GPACKS_PATH/package/python-cachetools/Config.in"
source "$BR2_EXTERNAL_GPACKS_PATH/package/python-googleapis-common-protos/Config.in"
source "$BR2_EXTERNAL_GPACKS_PATH/package/python-google-assistant-grpc/Config.in"
source "$BR2_EXTERNAL_GPACKS_PATH/package/python-google-assistant-library/Config.in"
source "$BR2_EXTERNAL_GPACKS_PATH/package/python-google-assistant-sdk/Config.in"
source "$BR2_EXTERNAL_GPACKS_PATH/package/python-google-auth/Config.in"
source "$BR2_EXTERNAL_GPACKS_PATH/package/python-google-auth-oauthlib/Config.in"
source "$BR2_EXTERNAL_GPACKS_PATH/package/python-grpcio/Config.in"
source "$BR2_EXTERNAL_GPACKS_PATH/package/python-pyasn1/Config.in"
source "$BR2_EXTERNAL_GPACKS_PATH/package/python-pyasn1-modules/Config.in"
source "$BR2_EXTERNAL_GPACKS_PATH/package/python-rsa/Config.in"
source "$BR2_EXTERNAL_GPACKS_PATH/package/python-sounddevice/Config.in"
source "$BR2_EXTERNAL_GPACKS_PATH/package/python-tenacity/Config.in"
```

## br-google/package/python-google-assistant-grpc/Config.in
```kconfig
config BR2_PACKAGE_PYTHON_GOOGLE_ASSISTANT_GRPC
	bool "python-google-assistant-grpc"
	select BR2_PACKAGE_PYTHON_GOOGLEAPIS_COMMON_PROTOS # runtime
	select BR2_PACKAGE_PYTHON_GRPCIO # runtime
	help
	  Google Assistant API gRPC bindings.

	  https://github.com/googlesamples/assistant-sdk-python
```

## br-google/package/python-google-assistant-library/Config.in
```kconfig
config BR2_PACKAGE_PYTHON_GOOGLE_ASSISTANT_LIBRARY
	bool "python-google-assistant-library"
	help
	  Google Assistant Library
```

## br-google/package/python-google-assistant-sdk/Config.in
```kconfig
config BR2_PACKAGE_PYTHON_GOOGLE_ASSISTANT_SDK
	bool "python-google-assistant-sdk"
	select BR2_PACKAGE_PYTHON_CLICK
	select BR2_PACKAGE_PYTHON_GOOGLE_ASSISTANT_GRPC
	select BR2_PACKAGE_PYTHON_GOOGLE_AUTH_OAUTHLIB
	select BR2_PACKAGE_PYTHON_PATHLIB2
	select BR2_PACKAGE_PYTHON_SOUNDDEVICE
	select BR2_PACKAGE_PYTHON_URLLIB3

	help
	  This package contains a collection of samples and tools to help
	  you get started with the `Google Assistant SDK`_ using `Python`_.

	  https://pypi.org/project/google-assistant-sdk
```

## br-google/package/python-google-auth-oauthlib/Config.in
```kconfig
config BR2_PACKAGE_PYTHON_GOOGLE_AUTH_OAUTHLIB
	bool "python-google-auth-oauthlib"
	select BR2_PACKAGE_PYTHON_GOOGLE_AUTH # runtime
	select BR2_PACKAGE_PYTHON_REQUESTS_OAUTHLIB # runtime
	help
	  Google Authentication Library.

	  https://github.com/GoogleCloudPlatform/google-auth-library-python-oauthlib
```

## br-google/package/python-grpcio/Config.in
```kconfig
config BR2_PACKAGE_PYTHON_GRPCIO
	bool "python-grpcio"
	select BR2_PACKAGE_C_ARES
	select BR2_PACKAGE_PYTHON_SIX # runtime
	select BR2_PACKAGE_PYTHON_FUTURES if BR2_PACKAGE_PYTHON # runtime
	select BR2_PACKAGE_PYTHON_ENUM34 if BR2_PACKAGE_PYTHON # runtime
	help
	  HTTP/2-based RPC framework.

	  https://grpc.io
```

## br-google/package/python-sounddevice/Config.in
```kconfig
config BR2_PACKAGE_PYTHON_SOUNDDEVICE
	bool "python-sounddevice"
	select BR2_PACKAGE_PYTHON_CFFI # runtime
	help
	  Play and Record Sound with Python.

	  http://python-sounddevice.readthedocs.io/
```

## br-google/package/python-tenacity/Config.in
```kconfig
config BR2_PACKAGE_PYTHON_TENACITY
	bool "python-tenacity"
	help
	  Tenacity is an Apache 2.0 licensed general-purpose retrying library,
	  written in Python, to simplify the task of adding retry behavior to
	  just about anything.

	  https://pypi.org/project/tenacity
```
